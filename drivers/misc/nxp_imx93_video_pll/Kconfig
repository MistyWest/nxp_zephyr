## drivers/misc/nxp_imx93_video_pll/Kconfig
```kconfig
config NXP_IMX93_VIDEO_PLL
    bool "Initialize NXP iMX93 VIDEO PLL"
    default y
    help
      Enable initialization of VIDEO PLL using device tree configuration.
```

## dts/bindings/p_state/nxp,mcxn23x.yaml
```yaml
# Copyright 2025 NXP
#
# SPDX-License-Identifier: Apache-2.0

description: |
  NXP MCXN23x implementation of custom properties for performance state (pstate)

compatible: "nxp,mcxn23x-pstate"

include:
  - "zephyr,pstate.yaml"

properties:
  cpu-frequency-level:
    type: string
    enum:
      - low
      - medium
      - high
    description: |
      CPU frequency level associated with this performance state. The frequency
      level correspond to predefined CPU frequency levels supported by the SoC.
```
